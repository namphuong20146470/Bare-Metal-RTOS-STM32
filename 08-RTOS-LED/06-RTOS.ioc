# file: 06-RTOS.ioc
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Mcu.Family=STM32F4
Mcu.Name=STM32F401R(D-E)Tx
Mcu.Package=LQFP64
NVIC.PriorityGroup=NVIC_PRIORITYGROUP_4
NVIC.TIM1_BRK_TIM9_IRQn=true\:15\:0\:false\:false\:true\:false\:true\:true
NVIC.TimeBase=TIM1_BRK_TIM9_IRQn
NVIC.TimeBaseIP=TIM9
ProjectManager.HeapSize=0x200
ProjectManager.StackSize=0x400
ProjectManager.TargetToolchain=STM32CubeIDE
RCC.48MHZClocksFreq_Value=42000000
RCC.AHBFreq_Value=84000000
RCC.APB1CLKDivider=RCC_HCLK_DIV2
RCC.APB1Freq_Value=42000000
RCC.APB1TimFreq_Value=84000000
RCC.APB2Freq_Value=84000000
RCC.APB2TimFreq_Value=84000000
RCC.CortexFreq_Value=84000000
RCC.HCLKFreq_Value=84000000
RCC.HSE_VALUE=25000000
RCC.HSI_VALUE=16000000
RCC.LSE_VALUE=32768
RCC.PLLM=8
RCC.PLLN=84
RCC.SYSCLKFreq_VALUE=84000000
RCC.SYSCLKSource=RCC_SYSCLKSOURCE_PLLCLK
RCC.VCOOutputFreq_Value=168000000
VP_SYS_VS_tim9.Mode=TIM9
board=custom

// file: Core/Src/main.c
/* USER CODE BEGIN Header */
/**
 ******************************************************************************
 * @file           : main.c
 * @brief          : Main program body - RGB LED Control with FreeRTOS
 ******************************************************************************
 */
/* USER CODE END Header */
#include "main.h"

/* USER CODE BEGIN Includes */
#include "FreeRTOS.h"
#include "task.h"
#include "semphr.h"
#include <stdio.h>
/* USER CODE END Includes */

/* USER CODE BEGIN PD */
#define STACK_SIZE 128
#define GPIOAEN (1UL << 0) // GPIOA clock enable
#define GPIOCEN (1UL << 2) // GPIOC clock enable

// LED Pins on GPIOA
#define RED_LED_PIN (1UL << 8)    // RED LED on PA8
#define BLUE_LED_PIN (1UL << 9)   // BLUE LED on PA9
#define GREEN_LED_PIN (1UL << 10) // GREEN LED on PA10

// LED states
#define LED_ON 1
#define LED_OFF 0

/* USER CODE END PD */

/* USER CODE BEGIN PV */
// Semaphores for LED sequence control
SemaphoreHandle_t xRedSemaphore;
SemaphoreHandle_t xBlueSemaphore;
SemaphoreHandle_t xGreenSemaphore;
/* USER CODE END PV */

void SystemClock_Config(void);
/* USER CODE BEGIN PFP */
void vRedLedTask(void *pvParameters);   // Task for RED LED
void vBlueLedTask(void *pvParameters);  // Task for BLUE LED
void vGreenLedTask(void *pvParameters); // Task for GREEN LED
void SEGGER_UART_init(uint32_t baud);
void SEGGER_SYSVIEW_Conf(void);
void SEGGER_SYSVIEW_PrintfTarget(const char *fmt, ...);
/* USER CODE END PFP */

/* USER CODE BEGIN 0 */
#define DWT_CTRL (*(volatile uint32_t *)0xE0001000)

// Helper function to control LED
void controlLed(uint32_t pin, uint8_t state)
{
  if (state == LED_ON)
  {
    GPIOA->BSRR = pin; // Turn LED ON
  }
  else
  {
    GPIOA->BSRR = (pin << 16); // Turn LED OFF
  }
}
/* USER CODE END 0 */

int main(void)
{
  /* USER CODE BEGIN 1 */
  TaskHandle_t redTaskHandle;
  TaskHandle_t blueTaskHandle;
  TaskHandle_t greenTaskHandle;
  BaseType_t status;
  /* USER CODE END 1 */

  /* MCU Configuration--------------------------------------------------------*/

  /* Reset of all peripherals, Initializes the Flash interface and the Systick. */
  HAL_Init();

  /* Configure the system clock */
  SystemClock_Config();

  /* Initialize all configured peripherals */
  /* USER CODE BEGIN 2 */
  // Enable GPIO clocks
  RCC->AHB1ENR |= GPIOAEN | GPIOCEN;

  // Configure PA8, PA9, PA10 (RGB LEDs) as outputs
  GPIOA->MODER &= ~(3UL << (8 * 2)); // Clear mode bits for PA8
  GPIOA->MODER |= (1UL << (8 * 2));  // Set PA8 to output mode (RED)

  GPIOA->MODER &= ~(3UL << (9 * 2)); // Clear mode bits for PA9
  GPIOA->MODER |= (1UL << (9 * 2));  // Set PA9 to output mode (BLUE)

  GPIOA->MODER &= ~(3UL << (10 * 2)); // Clear mode bits for PA10
  GPIOA->MODER |= (1UL << (10 * 2));  // Set PA10 to output mode (GREEN)

  // Configure PC13 (Button) as input with pull-up
  GPIOC->MODER &= ~(3UL << (13 * 2)); // Clear mode bits for pin 13 (input mode = 00)
  GPIOC->PUPDR &= ~(3UL << (13 * 2)); // Clear pull-up/pull-down
  GPIOC->PUPDR |= (1UL << (13 * 2));  // Set to pull-up (01)

  // Ensure all LEDs are OFF initially
  controlLed(RED_LED_PIN, LED_OFF);
  controlLed(BLUE_LED_PIN, LED_OFF);
  controlLed(GREEN_LED_PIN, LED_OFF);

  // Initialize Segger debug
  DWT_CTRL |= (1 << 0);     // Enable DWT
  SEGGER_UART_init(500000); // Initialize SEGGER UART
  SEGGER_SYSVIEW_Conf();    // Initialize SEGGER SystemView

  // Create semaphores for LED sequence control
  xRedSemaphore = xSemaphoreCreateBinary();
  xBlueSemaphore = xSemaphoreCreateBinary();
  xGreenSemaphore = xSemaphoreCreateBinary();

  // Give the first semaphore to start the sequence with RED
  xSemaphoreGive(xRedSemaphore);

  /* Create the three LED tasks */
  status = xTaskCreate(vRedLedTask, "RED LED Task", 200, NULL, 2, &redTaskHandle);
  configASSERT(status == pdPASS);

  status = xTaskCreate(vBlueLedTask, "BLUE LED Task", 200, NULL, 2, &blueTaskHandle);
  configASSERT(status == pdPASS);

  status = xTaskCreate(vGreenLedTask, "GREEN LED Task", 200, NULL, 2, &greenTaskHandle);
  configASSERT(status == pdPASS);

  // Start the scheduler
  vTaskStartScheduler();

  /* USER CODE END 2 */

  /* Infinite loop */
  while (1)
  {

    /* USER CODE BEGIN 3 */
    /* Code will never reach here if the scheduler is running */
  }
  /* USER CODE END 3 */
}

void SystemClock_Config(void)
{
  RCC_OscInitTypeDef RCC_OscInitStruct = {0};
  RCC_ClkInitTypeDef RCC_ClkInitStruct = {0};

  /** Configure the main internal regulator output voltage
   */
  __HAL_RCC_PWR_CLK_ENABLE();
  __HAL_PWR_VOLTAGESCALING_CONFIG(PWR_REGULATOR_VOLTAGE_SCALE2);

  /** Initializes the RCC Oscillators according to the specified parameters
   * in the RCC_OscInitTypeDef structure.
   */
  RCC_OscInitStruct.OscillatorType = RCC_OSCILLATORTYPE_HSI;
  RCC_OscInitStruct.HSIState = RCC_HSI_ON;
  RCC_OscInitStruct.HSICalibrationValue = RCC_HSICALIBRATION_DEFAULT;
  RCC_OscInitStruct.PLL.PLLState = RCC_PLL_ON;
  RCC_OscInitStruct.PLL.PLLSource = RCC_PLLSOURCE_HSI;
  RCC_OscInitStruct.PLL.PLLM = 8;
  RCC_OscInitStruct.PLL.PLLN = 84;
  RCC_OscInitStruct.PLL.PLLP = RCC_PLLP_DIV2;
  RCC_OscInitStruct.PLL.PLLQ = 4;
  if (HAL_RCC_OscConfig(&RCC_OscInitStruct) != HAL_OK)
  {
    Error_Handler();
  }

  /** Initializes the CPU, AHB and APB buses clocks
   */
  RCC_ClkInitStruct.ClockType = RCC_CLOCKTYPE_HCLK | RCC_CLOCKTYPE_SYSCLK | RCC_CLOCKTYPE_PCLK1 | RCC_CLOCKTYPE_PCLK2;
  RCC_ClkInitStruct.SYSCLKSource = RCC_SYSCLKSOURCE_PLLCLK;
  RCC_ClkInitStruct.AHBCLKDivider = RCC_SYSCLK_DIV1;
  RCC_ClkInitStruct.APB1CLKDivider = RCC_HCLK_DIV2;
  RCC_ClkInitStruct.APB2CLKDivider = RCC_HCLK_DIV1;

  if (HAL_RCC_ClockConfig(&RCC_ClkInitStruct, FLASH_LATENCY_2) != HAL_OK)
  {
    Error_Handler();
  }
}

/* USER CODE BEGIN 4 */
/* RED LED Task - First in the sequence */
void vRedLedTask(void *pvParameters)
{
  const TickType_t xDelay = pdMS_TO_TICKS(500); // 500ms delay

  while (1)
  {
    // Wait for permission to turn on RED LED
    if (xSemaphoreTake(xRedSemaphore, portMAX_DELAY) == pdTRUE)
    {
      SEGGER_SYSVIEW_PrintfTarget("RED LED ON");

      // Turn ON the RED LED
      controlLed(RED_LED_PIN, LED_ON);

      // Keep LED on for the delay period
      vTaskDelay(xDelay);

      // Turn OFF the RED LED
      controlLed(RED_LED_PIN, LED_OFF);

      // Signal BLUE LED to turn on next
      xSemaphoreGive(xBlueSemaphore);
    }
  }
}

/* BLUE LED Task - Second in the sequence */
void vBlueLedTask(void *pvParameters)
{
  const TickType_t xDelay = pdMS_TO_TICKS(500); // 500ms delay

  while (1)
  {
    // Wait for permission to turn on BLUE LED
    if (xSemaphoreTake(xBlueSemaphore, portMAX_DELAY) == pdTRUE)
    {
      SEGGER_SYSVIEW_PrintfTarget("BLUE LED ON");

      // Turn ON the BLUE LED
      controlLed(BLUE_LED_PIN, LED_ON);

      // Keep LED on for the delay period
      vTaskDelay(xDelay);

      // Turn OFF the BLUE LED
      controlLed(BLUE_LED_PIN, LED_OFF);

      // Signal GREEN LED to turn on next
      xSemaphoreGive(xGreenSemaphore);
    }
  }
}

/* GREEN LED Task - Third in the sequence */
void vGreenLedTask(void *pvParameters)
{
  const TickType_t xDelay = pdMS_TO_TICKS(500); // 500ms delay

  while (1)
  {
    // Wait for permission to turn on GREEN LED
    if (xSemaphoreTake(xGreenSemaphore, portMAX_DELAY) == pdTRUE)
    {
      SEGGER_SYSVIEW_PrintfTarget("GREEN LED ON");

      // Turn ON the GREEN LED
      controlLed(GREEN_LED_PIN, LED_ON);

      // Keep LED on for the delay period
      vTaskDelay(xDelay);

      // Turn OFF the GREEN LED
      controlLed(GREEN_LED_PIN, LED_OFF);

      // Signal RED LED to start the sequence again
      xSemaphoreGive(xRedSemaphore);
    }
  }
}

/* FreeRTOS Hook Functions */
void vApplicationIdleHook(void)
{
  /* This function is called when the idle task is running */
  /* You can add power saving code here */
}

void vApplicationMallocFailedHook(void)
{
  /* This function is called when memory allocation fails */
  /* Handle error here, e.g., restart the system */
  printf("Memory allocation failed!\r\n");
  Error_Handler();
}
/* USER CODE END 4 */

void HAL_TIM_PeriodElapsedCallback(TIM_HandleTypeDef *htim)
{
  if (htim->Instance == TIM9)
  {
    HAL_IncTick();
  }
}

void Error_Handler(void)
{
  __disable_irq();
  while (1)
  {
  }
}
